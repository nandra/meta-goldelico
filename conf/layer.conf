## conf/layer.conf
```bitbake
# We have a conf and classes directory, add to BBPATH
BBPATH .= ":${LAYERDIR}"

# We have a recipes-* directories, add to BBFILES
BBFILES += "${LAYERDIR}/recipes-*/*/*.bb \
	${LAYERDIR}/recipes-*/*/*.bbappend"

BBFILE_COLLECTIONS += "goldelico"
BBFILE_PATTERN_goldelico = "^${LAYERDIR}/"
BBFILE_PRIORITY_goldelico = "6"
```

## conf/machine/letux-cortex-a8.conf
```bitbake
#@TYPE: Machine
#@NAME: letux-cortex-a8

#@DESCRIPTION: Machine configuration for letux cortex a8 machine

MACHINE_EXTRA_RRECOMMENDS = " kernel-modules kernel-devicetree"

EXTRA_IMAGEDEPENDS += "u-boot"

DEFAULTTUNE ?= "cortexa8hf-neon"
include conf/machine/include/tune-cortexa8.inc

IMAGE_FSTYPES += "ext4 tar.gz"

SERIAL_CONSOLE = "115200 ttyO0"

PREFERRED_PROVIDER_virtual/kernel ?= "linux-yocto-goldelico"
PREFERRED_PROVIDER_u-boot ?= "u-boot-goldelico"

KERNEL_IMAGETYPE = "uImage"
KERNEL_DEVICETREE = "am335x-letux-cortex8.dtb"
KERNEL_EXTRA_ARGS += "LOADADDR=${UBOOT_ENTRYPOINT}"

SPL_BINARY = "MLO"
UBOOT_SUFFIX = "img"
UBOOT_MACHINE ?= "letux_cortex8_defconfig"
UBOOT_ENTRYPOINT = "0x80008000"
UBOOT_LOADADDRESS = "0x80008000"

MACHINE_FEATURES = "usbgadget usbhost vfat"

IMAGE_BOOT_FILES ?= "u-boot.${UBOOT_SUFFIX} MLO"
```
